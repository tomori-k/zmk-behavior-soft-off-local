## Kconfig
```kconfig
# DT_COMPAT_ZMK_BEHAVIOR_SOFT_OFF_LOCAL := zmk,behavior-soft-off-local

config ZMK_BEHAVIOR_SOFT_OFF_LOCAL
    bool
    default y
    # default $(dt_compat_enabled,$(DT_COMPAT_ZMK_BEHAVIOR_SOFT_OFF_LOCAL))
    # depends on ZMK_PM_SOFT_OFF
    depends on DT_HAS_ZMK_BEHAVIOR_SOFT_OFF_LOCAL_ENABLED && ZMK_PM_SOFT_OFF
```

## dts/bindings/behaviors/zmk,behavior-soft-off-local.yml
```yaml
description: Soft-off behavior that turns off one side of a split keyboard

compatible: "zmk,behavior-soft-off-local"

include: zero_param.yaml

properties: {}
```
